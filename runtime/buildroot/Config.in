## runtime/buildroot/Config.in
```kconfig
menu "Sealbuild guest runtime"

source "$BR2_EXTERNAL_SEALBUILD_PATH/package/sealbuild-buildkit/Config.in"
source "$BR2_EXTERNAL_SEALBUILD_PATH/package/sealbuild-runc/Config.in"
source "$BR2_EXTERNAL_SEALBUILD_PATH/package/sealbuild-cni-plugins/Config.in"

endmenu
```

## runtime/buildroot/configs/sealbuild_x86_64_defconfig
```kconfig
BR2_x86_64=y
BR2_PACKAGE_HOST_LINUX_HEADERS_CUSTOM_6_18=y
BR2_TOOLCHAIN_BUILDROOT_MUSL=y
BR2_SYSTEM_DHCP="eth0"
BR2_TARGET_GENERIC_GETTY_PORT="ttyS0"
BR2_ROOTFS_OVERLAY="$(BR2_EXTERNAL_SEALBUILD_PATH)/board/sealbuild/x86_64/rootfs-overlay"
BR2_ROOTFS_POST_BUILD_SCRIPT="$(BR2_EXTERNAL_SEALBUILD_PATH)/board/sealbuild/x86_64/post-build.sh"
BR2_LINUX_KERNEL=y
BR2_LINUX_KERNEL_CUSTOM_VERSION=y
BR2_LINUX_KERNEL_CUSTOM_VERSION_VALUE="6.18.7"
BR2_LINUX_KERNEL_USE_CUSTOM_CONFIG=y
BR2_LINUX_KERNEL_CUSTOM_CONFIG_FILE="$(BR2_EXTERNAL_SEALBUILD_PATH)/board/sealbuild/x86_64/linux.config"
BR2_LINUX_KERNEL_NEEDS_HOST_LIBELF=y
BR2_PACKAGE_CA_CERTIFICATES=y
BR2_PACKAGE_CGROUPFS_V2_MOUNT=y
BR2_PACKAGE_SEALBUILD_BUILDKIT=y
BR2_PACKAGE_SEALBUILD_RUNC=y
BR2_PACKAGE_SEALBUILD_CNI_PLUGINS=y
BR2_TARGET_ROOTFS_EXT2=y
BR2_TARGET_ROOTFS_EXT2_4=y
BR2_TARGET_ROOTFS_EXT2_SIZE="192M"
# BR2_TARGET_ROOTFS_TAR is not set
```

## runtime/buildroot/package/sealbuild-buildkit/Config.in
```kconfig
config BR2_PACKAGE_SEALBUILD_BUILDKIT
	bool "sealbuild-buildkit"
	depends on BR2_x86_64
	help
	  Installs the pinned linux/amd64 buildkitd used by Sealbuild.
```

## runtime/buildroot/package/sealbuild-cni-plugins/Config.in
```kconfig
config BR2_PACKAGE_SEALBUILD_CNI_PLUGINS
	bool "sealbuild-cni-plugins"
	depends on BR2_x86_64
	select BR2_PACKAGE_IPTABLES
	help
	  Installs the four pinned CNI plugins required by BuildKit bridge mode.
```

## runtime/buildroot/package/sealbuild-runc/Config.in
```kconfig
config BR2_PACKAGE_SEALBUILD_RUNC
	bool "sealbuild-runc"
	depends on BR2_x86_64
	help
	  Installs the pinned linux/amd64 runc used by Sealbuild.
```
